## drivers/net/dsa/Kconfig
```kconfig
menu "Distributed Switch Architecture drivers"
	depends on HAVE_NET_DSA

config NET_DSA_MV88E6XXX
	tristate
	default n

config NET_DSA_MV88E6060
	tristate "Marvell 88E6060 ethernet switch chip support"
	depends on NET_DSA
	select NET_DSA_TAG_TRAILER
	---help---
	  This enables support for the Marvell 88E6060 ethernet switch
	  chip.

config NET_DSA_MV88E6XXX_NEED_PPU
	bool
	default n

config NET_DSA_MV88E6131
	tristate "Marvell 88E6085/6095/6095F/6131 ethernet switch chip support"
	depends on NET_DSA
	select NET_DSA_MV88E6XXX
	select NET_DSA_MV88E6XXX_NEED_PPU
	select NET_DSA_TAG_DSA
	---help---
	  This enables support for the Marvell 88E6085/6095/6095F/6131
	  ethernet switch chips.

config NET_DSA_MV88E6123_61_65
	tristate "Marvell 88E6123/6161/6165 ethernet switch chip support"
	depends on NET_DSA
	select NET_DSA_MV88E6XXX
	select NET_DSA_TAG_EDSA
	---help---
	  This enables support for the Marvell 88E6123/6161/6165
	  ethernet switch chips.

config NET_DSA_MV88E6171
	tristate "Marvell 88E6171/6175/6350/6351 ethernet switch chip support"
	depends on NET_DSA
	select NET_DSA_MV88E6XXX
	select NET_DSA_TAG_EDSA
	---help---
	  This enables support for the Marvell 88E6171/6175/6350/6351
	  ethernet switches chips.

config NET_DSA_MV88E6352
	tristate "Marvell 88E6172/6176/6320/6321/6352 ethernet switch chip support"
	depends on NET_DSA
	select NET_DSA_MV88E6XXX
	select NET_DSA_TAG_EDSA
	---help---
	  This enables support for the Marvell 88E6172, 88E6176, 88E6320,
	  88E6321 and 88E6352 ethernet switch chips.

config NET_DSA_BCM_SF2
	tristate "Broadcom Starfighter 2 Ethernet switch support"
	depends on HAS_IOMEM && NET_DSA
	select NET_DSA_TAG_BRCM
	select FIXED_PHY
	select BCM7XXX_PHY
	select MDIO_BCM_UNIMAC
	---help---
	  This enables support for the Broadcom Starfighter 2 Ethernet
	  switch chips.


config KSZ_STP
	bool "STP support"
	depends on KSZ_SWITCH
	default n
	help
	  Enable STP support.

menuconfig KSZ_SWITCHES
	tristate "Drivers for Microchip KSZ switches"
	---help---
	  Supports Microchip KSZ switches.

if KSZ_SWITCHES

comment "Microchip KSZ switch device drivers"

config KSZ_SWITCH
	bool
	default n

config KSZ_DSA
	bool
	default n

config KSZ_SWITCH_EMBEDDED
	bool
	default n
	select KSZ_SWITCH

config HAVE_KSZ8863
	bool
	default n

config HAVE_SPI_KSZ8863
	bool
	default n
	select HAVE_KSZ8863

config I2C_KSZ8863
	tristate "I2C driver for Microchip KSZ8863 switch"
	select KSZ_SWITCH if !NET_DSA_TAG_TAIL
	select KSZ_DSA if NET_DSA_TAG_TAIL
	select HAVE_KSZ8863
	---help---
	  Supports the Microchip KSZ8863 switch.

config SPI_KSZ8863
	tristate "SPI driver for Microchip KSZ8863 switch"
	select KSZ_SWITCH if !NET_DSA_TAG_TAIL
	select KSZ_DSA if NET_DSA_TAG_TAIL
	select HAVE_SPI_KSZ8863
	---help---
	  Supports the Microchip KSZ8863 switch.

config KSZ8863_EMBEDDED
	bool "Microchip KSZ8863 switch support in network controller"
	depends on I2C_KSZ8863 = n && SPI_KSZ8863 = n && !NET_DSA_TAG_TAIL
	select KSZ_SWITCH_EMBEDDED
	select HAVE_SPI_KSZ8863
	---help---
	  Supports the Microchip KSZ8863 switch used within a network controller.

endif


endmenu
```
